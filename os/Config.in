## os/Config.in
```kconfig
source "$BR2_EXTERNAL_EITRI_PATH/package/go2rtc/Config.in"
source "$BR2_EXTERNAL_EITRI_PATH/package/uv/Config.in"
source "$BR2_EXTERNAL_EITRI_PATH/package/eitri-ustreamer/Config.in"
source "$BR2_EXTERNAL_EITRI_PATH/package/eitri-katapult/Config.in"
source "$BR2_EXTERNAL_EITRI_PATH/package/eitri-fluidd/Config.in"
source "$BR2_EXTERNAL_EITRI_PATH/package/eitri-mainsail/Config.in"
source "$BR2_EXTERNAL_EITRI_PATH/package/eitri-camera/Config.in"
source "$BR2_EXTERNAL_EITRI_PATH/package/eitri-mcuflash/Config.in"
source "$BR2_EXTERNAL_EITRI_PATH/package/eitri-configurator/Config.in"
source "$BR2_EXTERNAL_EITRI_PATH/package/eitri-klipper-layer/Config.in"
```

## os/configs/eitri_plus4_defconfig
```kconfig
# Eitri OS: Buildroot defconfig for the QIDI X-Plus 4 (Makerbase MKS-PI, Rockchip RK3328).
# Used through BR2_EXTERNAL=os/. Build with "make -C os image".

# --- Architecture and toolchain ---------------------------------------------
# Buildroot builds its own glibc toolchain against the Linux 6.18 headers that
# match the kernel. A prebuilt external toolchain (kernel headers 5.4) was tried
# first and fails on packages that need newer headers: rsync wants linux/openat2.h.
BR2_aarch64=y
BR2_cortex_a53=y
BR2_PACKAGE_HOST_LINUX_HEADERS_CUSTOM_6_18=y
BR2_TOOLCHAIN_BUILDROOT_GLIBC=y
BR2_TOOLCHAIN_BUILDROOT_CXX=y

# --- Reproducibility --------------------------------------------------------
BR2_DOWNLOAD_FORCE_CHECK_HASHES=y
BR2_GLOBAL_PATCH_DIR="$(BR2_EXTERNAL_EITRI_PATH)/board/eitri-plus4/patches"
BR2_REPRODUCIBLE=y
BR2_CCACHE=y

# --- System -----------------------------------------------------------------
BR2_INIT_SYSTEMD=y
# BR2_TARGET_GENERIC_REMOUNT_ROOTFS_RW is not set
BR2_INIT_SYSTEMD_VAR_FACTORY=y
BR2_TARGET_GENERIC_HOSTNAME="eitri"
BR2_TARGET_GENERIC_ISSUE="Eitri OS"
BR2_TARGET_TZ_INFO=y
BR2_TARGET_LOCALTIME="UTC"
BR2_SYSTEM_BIN_SH_BASH=y
BR2_ROOTFS_USERS_TABLES="$(BR2_EXTERNAL_EITRI_PATH)/board/eitri-plus4/users.table"
BR2_ROOTFS_OVERLAY="$(BR2_EXTERNAL_EITRI_PATH)/board/eitri-plus4/rootfs-overlay"
BR2_ROOTFS_POST_BUILD_SCRIPT="$(BR2_EXTERNAL_EITRI_PATH)/board/eitri-plus4/post-build.sh"
BR2_ROOTFS_POST_IMAGE_SCRIPT="$(BR2_EXTERNAL_EITRI_PATH)/board/eitri-plus4/post-image.sh support/scripts/genimage.sh $(BR2_EXTERNAL_EITRI_PATH)/board/eitri-plus4/post-bundle.sh"
BR2_ROOTFS_POST_SCRIPT_ARGS="-c $(BR2_EXTERNAL_EITRI_PATH)/board/eitri-plus4/genimage.cfg"

# --- Kernel: mainline Linux 6.18 LTS ----------------------------------------
BR2_LINUX_KERNEL=y
BR2_LINUX_KERNEL_CUSTOM_VERSION=y
BR2_LINUX_KERNEL_CUSTOM_VERSION_VALUE="6.18.57"
BR2_LINUX_KERNEL_USE_ARCH_DEFAULT_CONFIG=y
BR2_LINUX_KERNEL_CONFIG_FRAGMENT_FILES="$(BR2_EXTERNAL_EITRI_PATH)/board/eitri-plus4/linux.fragment"
BR2_LINUX_KERNEL_DTS_SUPPORT=y
BR2_LINUX_KERNEL_CUSTOM_DTS_PATH="$(BR2_EXTERNAL_EITRI_PATH)/board/eitri-plus4/dts/rk3328-eitri-plus4.dts"
BR2_LINUX_KERNEL_INSTALL_TARGET=y
BR2_LINUX_KERNEL_NEEDS_HOST_OPENSSL=y
BR2_LINUX_KERNEL_NEEDS_HOST_PYTHON3=y

# --- Bootloader: TF-A BL31 and U-Boot v2026.10 -------------------------------
BR2_TARGET_ARM_TRUSTED_FIRMWARE=y
BR2_TARGET_ARM_TRUSTED_FIRMWARE_CUSTOM_VERSION=y
BR2_TARGET_ARM_TRUSTED_FIRMWARE_CUSTOM_VERSION_VALUE="da738d5eae93af342fdc4995dd3c05acb4c9d757"
BR2_TARGET_ARM_TRUSTED_FIRMWARE_PLATFORM="rk3328"
BR2_TARGET_ARM_TRUSTED_FIRMWARE_IMAGES=""
BR2_TARGET_UBOOT=y
BR2_TARGET_UBOOT_BUILD_SYSTEM_KCONFIG=y
BR2_TARGET_UBOOT_CUSTOM_TARBALL=y
BR2_TARGET_UBOOT_CUSTOM_TARBALL_LOCATION="https://github.com/u-boot/u-boot/archive/refs/tags/v2026.10.tar.gz"
BR2_TARGET_UBOOT_BOARD_DEFCONFIG="roc-cc-rk3328"
BR2_TARGET_UBOOT_CONFIG_FRAGMENT_FILES="$(BR2_EXTERNAL_EITRI_PATH)/board/eitri-plus4/uboot.fragment"
BR2_TARGET_UBOOT_DEFAULT_ENV_FILE="$(BR2_EXTERNAL_EITRI_PATH)/board/eitri-plus4/uboot.env"
BR2_TARGET_UBOOT_NEEDS_DTC=y
BR2_TARGET_UBOOT_NEEDS_PYLIBFDT=y
BR2_TARGET_UBOOT_NEEDS_PYELFTOOLS=y
BR2_TARGET_UBOOT_NEEDS_OPENSSL=y
BR2_TARGET_UBOOT_NEEDS_UTIL_LINUX=y
BR2_TARGET_UBOOT_NEEDS_ATF_BL31=y
BR2_TARGET_UBOOT_NEEDS_ATF_BL31_ELF=y
BR2_TARGET_UBOOT_FORMAT_CUSTOM=y
BR2_TARGET_UBOOT_FORMAT_CUSTOM_NAME="u-boot.itb"
BR2_TARGET_UBOOT_SPL=y
BR2_TARGET_UBOOT_SPL_NAME="idbloader.img"

# --- Filesystems and images -------------------------------------------------
# One rootfs image per A/B slot. It carries the kernel and device tree in /boot.
BR2_TARGET_ROOTFS_EXT2=y
BR2_TARGET_ROOTFS_EXT2_4=y
BR2_TARGET_ROOTFS_EXT2_LABEL="rootfs"
BR2_TARGET_ROOTFS_EXT2_SIZE="640M"
BR2_TARGET_ROOTFS_EXT2_MKFS_OPTIONS="-O ^64bit,^has_journal,^metadata_csum_seed,^orphan_file,^huge_file,^inline_data -m 0"
# BR2_TARGET_ROOTFS_TAR is not set
BR2_PACKAGE_HOST_GENIMAGE=y
BR2_PACKAGE_HOST_DOSFSTOOLS=y
BR2_PACKAGE_HOST_MTOOLS=y
BR2_PACKAGE_HOST_E2FSPROGS=y
BR2_PACKAGE_HOST_UBOOT_TOOLS=y
BR2_PACKAGE_HOST_RAUC=y

# --- Core userland ----------------------------------------------------------
BR2_PACKAGE_BASH=y
BR2_PACKAGE_CA_CERTIFICATES=y
BR2_PACKAGE_LIBCURL=y
BR2_PACKAGE_LIBCURL_CURL=y
BR2_PACKAGE_LIBCURL_OPENSSL=y
BR2_PACKAGE_LIBSODIUM=y
BR2_PACKAGE_OPENSSL=y
BR2_PACKAGE_E2FSPROGS=y
BR2_PACKAGE_E2FSPROGS_RESIZE2FS=y
BR2_PACKAGE_DOSFSTOOLS=y
BR2_PACKAGE_DOSFSTOOLS_FSCK_FAT=y
BR2_PACKAGE_ETHTOOL=y
BR2_PACKAGE_GIT=y
BR2_PACKAGE_HTOP=y
BR2_PACKAGE_I2C_TOOLS=y
BR2_PACKAGE_IPROUTE2=y
BR2_PACKAGE_IPUTILS=y
BR2_PACKAGE_JQ=y
BR2_PACKAGE_LESS=y
BR2_PACKAGE_LIBGPIOD=y
BR2_PACKAGE_LIBGPIOD_TOOLS=y
BR2_PACKAGE_NANO=y
BR2_PACKAGE_RSYNC=y
BR2_PACKAGE_SUDO=y
BR2_PACKAGE_TMUX=y
BR2_PACKAGE_USBUTILS=y
BR2_PACKAGE_ZSTD=y
BR2_PACKAGE_UTIL_LINUX=y
BR2_PACKAGE_UTIL_LINUX_BINARIES=y
BR2_PACKAGE_UTIL_LINUX_PARTX=y
BR2_PACKAGE_UTIL_LINUX_ZRAMCTL=y
BR2_PACKAGE_UTIL_LINUX_MOUNTPOINT=y
BR2_PACKAGE_UTIL_LINUX_FALLOCATE=y

# --- systemd ---------------------------------------------------------------
BR2_PACKAGE_SYSTEMD=y
BR2_PACKAGE_SYSTEMD_HOSTNAMED=y
BR2_PACKAGE_SYSTEMD_LOCALED=y
BR2_PACKAGE_SYSTEMD_TIMEDATED=y
BR2_PACKAGE_SYSTEMD_LOGIND=y
BR2_PACKAGE_SYSTEMD_POLKIT=y
BR2_PACKAGE_SYSTEMD_RANDOMSEED=y
BR2_PACKAGE_SYSTEMD_ANALYZE=y
# BR2_PACKAGE_SYSTEMD_NETWORKD is not set
# BR2_PACKAGE_SYSTEMD_RESOLVED is not set
# BR2_PACKAGE_SYSTEMD_TIMESYNCD is not set
BR2_PACKAGE_DBUS=y
BR2_PACKAGE_POLKIT=y

# --- Python (applications live in uv venvs on /data) -----------------------
BR2_PACKAGE_PYTHON3=y
BR2_PACKAGE_PYTHON3_PY_PYC=y
BR2_PACKAGE_PYTHON3_BZIP2=y
BR2_PACKAGE_PYTHON3_CODECSCJK=y
BR2_PACKAGE_PYTHON3_READLINE=y
BR2_PACKAGE_PYTHON3_SSL=y
BR2_PACKAGE_PYTHON3_SQLITE=y
BR2_PACKAGE_PYTHON3_XZ=y
BR2_PACKAGE_PYTHON3_ZLIB=y
BR2_PACKAGE_PYTHON3_ZSTD=y
# BR2_PACKAGE_PYTHON_PIP is not set
BR2_PACKAGE_PYTHON_AIOHTTP=y
BR2_PACKAGE_PYTHON_SERIAL=y
BR2_PACKAGE_UV=y

# --- Network ---------------------------------------------------------------
BR2_PACKAGE_NETWORK_MANAGER=y
BR2_PACKAGE_NETWORK_MANAGER_CLI=y
BR2_PACKAGE_WPA_SUPPLICANT=y
BR2_PACKAGE_WPA_SUPPLICANT_NL80211=y
BR2_PACKAGE_WPA_SUPPLICANT_AP_SUPPORT=y
BR2_PACKAGE_WPA_SUPPLICANT_DBUS=y
BR2_PACKAGE_DNSMASQ=y
BR2_PACKAGE_NFTABLES=y
BR2_PACKAGE_IW=y
BR2_PACKAGE_WIRELESS_REGDB=y
BR2_PACKAGE_LINUX_FIRMWARE=y
BR2_PACKAGE_LINUX_FIRMWARE_RTL_81XX=y
# The RTL8710BU WiFi dongle ships as a fake CD-ROM (0bda:1a2b); usb_modeswitch
# flips it to the real device (0bda:b711) that rtl8xxxu + rtl8710bufw drive.
BR2_PACKAGE_USB_MODESWITCH=y
BR2_PACKAGE_OPENSSH=y
BR2_PACKAGE_OPENSSH_SERVER=y
BR2_PACKAGE_OPENSSH_KEY_UTILS=y
BR2_PACKAGE_AVAHI=y
BR2_PACKAGE_AVAHI_DAEMON=y
BR2_PACKAGE_LIBNSS=y
BR2_PACKAGE_NSS_MDNS=y
BR2_PACKAGE_CHRONY=y

# --- Web and camera ---------------------------------------------------------
BR2_PACKAGE_NGINX=y
BR2_PACKAGE_NGINX_HTTP_SSL_MODULE=y
BR2_PACKAGE_LIBV4L=y
BR2_PACKAGE_LIBV4L_UTILS=y
BR2_PACKAGE_EITRI_USTREAMER=y
BR2_PACKAGE_GO2RTC=y
BR2_PACKAGE_EITRI_CAMERA=y
BR2_PACKAGE_EITRI_FLUIDD=y
BR2_PACKAGE_EITRI_MAINSAIL=y

# --- Updates and Eitri tooling ---------------------------------------------
BR2_PACKAGE_RAUC=y
BR2_PACKAGE_RAUC_NETWORK=y
BR2_PACKAGE_RAUC_STREAMING=y
BR2_PACKAGE_RAUC_JSON=y
BR2_PACKAGE_EITRI_KATAPULT=y
BR2_PACKAGE_EITRI_MCUFLASH=y
BR2_PACKAGE_EITRI_CONFIGURATOR=y
```

## os/package/eitri-camera/Config.in
```kconfig
config BR2_PACKAGE_EITRI_CAMERA
	bool "eitri-camera"
	select BR2_PACKAGE_EITRI_USTREAMER
	select BR2_PACKAGE_LIBV4L
	select BR2_PACKAGE_LIBV4L_UTILS
	help
	  The Eitri camera layer (L3): systemd units, the /dev/eitri-cam
	  udev rule, the exposure helper, and the factory nginx,
	  Moonraker and go2rtc snippets. Built from the camera/
	  directory of this repository.
```

## os/package/eitri-configurator/Config.in
```kconfig
config BR2_PACKAGE_EITRI_CONFIGURATOR
	bool "eitri-configurator"
	select BR2_PACKAGE_PYTHON3
	select BR2_PACKAGE_PYTHON_AIOHTTP
	select BR2_PACKAGE_EITRI_MCUFLASH
	help
	  The first-run and maintenance web configurator (port 8099).
	  Built from the configurator/ directory of this repository and
	  installed as a source tree, because the application resolves
	  its web assets and release.lock relative to its own location.
```

## os/package/eitri-fluidd/Config.in
```kconfig
config BR2_PACKAGE_EITRI_FLUIDD
	bool "fluidd"
	help
	  Fluidd web interface for Klipper/Moonraker, installed as
	  static files under /usr/share/eitri/ui/fluidd. nginx serves it
	  when it is the active UI (see /data/eitri/ui).

	  https://github.com/fluidd-core/fluidd
```

## os/package/eitri-katapult/Config.in
```kconfig
config BR2_PACKAGE_EITRI_KATAPULT
	bool "katapult (flashtool scripts)"
	select BR2_PACKAGE_PYTHON3
	select BR2_PACKAGE_PYTHON_SERIAL
	help
	  The host-side scripts of Katapult (flashtool.py and friends),
	  used to put the toolhead MCU into its bootloader and flash it
	  over the existing UART. Only the scripts are installed; the
	  bootloader firmware itself is not built here.

	  https://github.com/Arksine/katapult
```

## os/package/eitri-klipper-layer/Config.in
```kconfig
config BR2_PACKAGE_EITRI_KLIPPER_LAYER
	bool "eitri-klipper-layer"
	select BR2_PACKAGE_PYTHON3
	help
	  The Eitri Klipper layer: the qd_* extras, the printer.cfg
	  template, the macros and scripts/overlay-install.sh, built from
	  the klipper-layer/ directory of this repository and installed as
	  /usr/lib/eitri/klipper-layer. The configurator renders printer.cfg
	  from it and links the extras into the Klipper/Kalico clone on
	  /data; nothing in that clone is ever modified.
```

## os/package/eitri-mainsail/Config.in
```kconfig
config BR2_PACKAGE_EITRI_MAINSAIL
	bool "mainsail"
	help
	  Mainsail web interface for Klipper/Moonraker, installed as
	  static files under /usr/share/eitri/ui/mainsail. nginx serves
	  it when it is the active UI (see /data/eitri/ui).

	  https://github.com/mainsail-crew/mainsail
```

## os/package/eitri-mcuflash/Config.in
```kconfig
config BR2_PACKAGE_EITRI_MCUFLASH
	bool "eitri-mcuflash"
	select BR2_PACKAGE_PYTHON3
	select BR2_PACKAGE_PYTHON_SERIAL
	select BR2_PACKAGE_EITRI_KATAPULT
	help
	  The MCU probe, backup, flash and verify tool (eitri-mcuflash).
	  Built from installer/mcuflash in this repository. It has no
	  third-party Python dependencies; pyserial is only needed for
	  the Katapult flashtool path.
```

## os/package/eitri-ustreamer/Config.in
```kconfig
config BR2_PACKAGE_EITRI_USTREAMER
	bool "ustreamer (Eitri pin)"
	depends on BR2_TOOLCHAIN_HEADERS_AT_LEAST_3_16 # V4L2_EVENT_SOURCE_CHANGE
	depends on BR2_TOOLCHAIN_HAS_THREADS # libbsd
	depends on !BR2_STATIC_LIBS # libbsd
	depends on BR2_PACKAGE_LIBBSD_ARCH_SUPPORTS # libbsd
	depends on BR2_USE_WCHAR # libbsd
	depends on !BR2_PACKAGE_USTREAMER
	select BR2_PACKAGE_JPEG
	select BR2_PACKAGE_LIBBSD
	select BR2_PACKAGE_LIBEVENT
	help
	  Lightweight MJPEG-over-HTTP streamer for the UVC camera.

	  Buildroot ships an older ustreamer (6.52 in the 2026.02 LTS).
	  Eitri pins the version in release.lock, so this package builds
	  the pinned release instead. Select either this package or the
	  stock one, not both.

	  https://github.com/pikvm/ustreamer

comment "ustreamer (Eitri pin) needs a toolchain w/ headers >= 3.16, threads, dynamic library, wchar"
	depends on BR2_PACKAGE_LIBBSD_ARCH_SUPPORTS
	depends on !BR2_TOOLCHAIN_HEADERS_AT_LEAST_3_16 || \
		!BR2_TOOLCHAIN_HAS_THREADS || \
		BR2_STATIC_LIBS || \
		!BR2_USE_WCHAR
```

## os/package/go2rtc/Config.in
```kconfig
config BR2_PACKAGE_GO2RTC
	bool "go2rtc"
	depends on BR2_aarch64
	help
	  Camera gateway: republishes the ustreamer MJPEG stream as RTSP
	  (and WebRTC when the source is H.264).

	  This installs the project's prebuilt, statically linked
	  linux_arm64 release binary. Buildroot has no go2rtc package
	  and no Go module vendoring is done here, so the binary is
	  pinned by SHA-256 in go2rtc.hash and in release.lock.

	  https://github.com/AlexxIT/go2rtc
```

## os/package/uv/Config.in
```kconfig
config BR2_PACKAGE_UV
	bool "uv"
	depends on BR2_aarch64
	depends on BR2_TOOLCHAIN_USES_GLIBC
	help
	  Fast Python package and virtual environment manager. Eitri
	  creates the Klipper and Moonraker virtual environments under
	  /data/venv with it.

	  This installs the project's prebuilt aarch64-unknown-linux-gnu
	  release binaries (uv and uvx), pinned by SHA-256.

	  https://github.com/astral-sh/uv

comment "uv needs a glibc toolchain"
	depends on BR2_aarch64
	depends on !BR2_TOOLCHAIN_USES_GLIBC
```
